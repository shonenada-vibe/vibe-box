## firmware/main/Kconfig.projbuild
```kconfig
menu "Vibe Box Config"

config VIBE_BOX_WIFI_SSID
    string "Wi-Fi SSID"
    default ""
    help
        Station mode SSID for the device.

config VIBE_BOX_WIFI_PASSWORD
    string "Wi-Fi password"
    default ""
    help
        Station mode password for the device.

config VIBE_BOX_PROVISIONING_AP_SSID
    string "Provisioning AP SSID"
    default "VibeBox-Setup"
    help
        SoftAP SSID exposed when runtime Wi-Fi credentials are missing or when the device
        falls back into provisioning mode.

config VIBE_BOX_PROVISIONING_AP_PASSWORD
    string "Provisioning AP password"
    default ""
    help
        Optional SoftAP password. Leave empty for an open provisioning network, or use
        at least 8 characters for WPA/WPA2 protection.

config VIBE_BOX_SERVER_BASE_URL
    string "Legacy thin server base URL"
    default "http://192.168.1.100:8000"
    help
        Legacy base URL for the previous thin server path. Direct Whisper mode uses
        VIBE_BOX_WHISPER_API_URL instead.

config VIBE_BOX_API_TOKEN
    string "Legacy thin server API token"
    default ""
    help
        Legacy bearer token for the previous thin server path. Direct Whisper mode uses
        VIBE_BOX_WHISPER_API_KEY instead.

config VIBE_BOX_WHISPER_API_URL
    string "Whisper-compatible API URL"
    default "http://192.168.1.100:8000/v1/audio/transcriptions"
    help
        Full Whisper-compatible transcription endpoint URL. The firmware sends captured
        WAV audio directly here as multipart/form-data with the file field named "file".

config VIBE_BOX_WHISPER_API_KEY
    string "Whisper-compatible API key"
    default ""
    help
        Optional bearer token sent to the Whisper-compatible transcription endpoint.

config VIBE_BOX_STT_MODEL
    string "STT model"
    default "whisper-large-v3-turbo"
    help
        Model form field sent to the Whisper-compatible transcription endpoint.

config VIBE_BOX_OPENAI_API_BASE
    string "OpenAI-compatible API base"
    default ""
    help
        Base URL for the OpenAI-compatible LLM API used for translation. Use a
        base such as https://api.openai.com/v1 or a full /chat/completions URL.

config VIBE_BOX_OPENAI_API_KEY
    string "OpenAI-compatible API key"
    default ""
    help
        Optional bearer token sent to the OpenAI-compatible translation API.

config VIBE_BOX_TRANSLATION_MODEL
    string "Translation LLM model"
    default "gpt-4o-mini"
    help
        Chat completions model name sent to the OpenAI-compatible translation API.

config VIBE_BOX_TRANSLATION_TARGET_LANGUAGE
    string "Translation target language"
    default "English"
    help
        Default target language for translated transcription output.

config VIBE_BOX_TRANSLATION_PROMPT
    string "Translation system prompt"
    default "You are a translation engine. Translate the user text to the target language. Return only the translated text."
    help
        System prompt sent with each translation request.

config VIBE_BOX_REFINE_PROMPT
    string "Refine system prompt"
    default "You are a text refinement engine. Rewrite the text to be fluent and natural while preserving the user's final intent. Remove filler words, repeated phrases, false starts, and self-corrections. If the speaker corrects themselves, keep only the corrected final meaning. Return only the refined text."
    help
        System prompt sent with each text refinement request.

config VIBE_BOX_TTS_ENABLED
    bool "Enable Volcengine TTS playback by default"
    default n
    help
        Enable synthesized speech playback after transcription, translation, and
        refinement complete. This is only the factory default; runtime BLE or
        provisioning config can still override it.

config VIBE_BOX_VOLC_TTS_APPID
    string "Volcengine TTS App ID"
    default ""
    help
        App ID sent in the Volcengine TTS app.appid field.

config VIBE_BOX_VOLC_TTS_API_KEY
    string "Volcengine TTS API key"
    default ""
    help
        API token sent in the Volcengine TTS app.token field and in the
        Authorization header as Bearer;token.

config VIBE_BOX_VOLC_TTS_VOICE_TYPE
    string "Volcengine TTS voice type"
    default ""
    help
        Voice type sent in the Volcengine TTS audio.voice_type field.

config VIBE_BOX_VOLC_TTS_CLUSTER
    string "Volcengine TTS cluster"
    default "volcano_tts"
    help
        Cluster sent in the Volcengine TTS app.cluster field.

config VIBE_BOX_DEVICE_ID
    string "Device ID"
    default "vibe-box-dev"
    help
        Logical device ID retained in runtime config and diagnostics.

config VIBE_BOX_FIRMWARE_VERSION
    string "Firmware version"
    default "dev"
    help
        Firmware version retained in runtime config and diagnostics.

config VIBE_BOX_LANGUAGE
    string "Language"
    default "zh"
    help
        Default language sent to the Whisper-compatible transcription endpoint.

config VIBE_BOX_RECORDING_DURATION_MS
    int "Recording duration (ms)"
    range 1000 15000
    default 3000
    help
        Target recording duration for microphone capture and upload.

config VIBE_BOX_RECORDING_MAX_MS
    int "Press-and-hold recording max duration (ms)"
    range 1000 120000
    default 60000
    help
        Safety cap for touch press-and-hold recording. The firmware stops or
        aborts a recording beyond this duration so a missed touch release cannot
        keep the microphone and I2S pipeline active indefinitely.

config VIBE_BOX_PWR_BUTTON_GPIO
    int "PWR button GPIO"
    range -1 48
    default 18
    help
        GPIO connected to the board PWR button. The Waveshare ESP32-S3-ePaper-1.54
        examples use GPIO18 and treat the button as active-low.

config VIBE_BOX_PWR_DOUBLE_CLICK_MS
    int "PWR double click window (ms)"
    range 150 1500
    default 500
    help
        Maximum interval between two PWR button releases to trigger BLE reinitialization.

config VIBE_BOX_PWR_LONG_PRESS_MS
    int "PWR long-press power-off / power-on duration (ms)"
    range 1000 15000
    default 3000
    help
        Hold the PWR button continuously for at least this long to power
        the device off (when on) or to confirm a power-on (when waking
        from deep sleep).

config VIBE_BOX_BOOT_RESTART_LONG_PRESS_MS
    int "BOOT long-press restart duration (ms)"
    range 1000 15000
    default 3000
    help
        Hold the BOOT button continuously for at least this long to restart
        the device.

config VIBE_BOX_ENABLE_I2S_CAPTURE
    bool "Enable I2S RX audio capture"
    default y
    help
        When enabled, the device captures real audio from an I2S RX data line and uploads
        that WAV payload from the board codec.

config VIBE_BOX_I2C_PORT
    int "Audio codec I2C port"
    range 0 1
    default 0
    help
        I2C controller index used to configure the on-board ES8311 codec.

config VIBE_BOX_I2C_SDA_GPIO
    int "Audio codec I2C SDA GPIO"
    range -1 48
    default 47
    help
        SDA GPIO connected to the board audio codec control bus.

config VIBE_BOX_I2C_SCL_GPIO
    int "Audio codec I2C SCL GPIO"
    range -1 48
    default 48
    help
        SCL GPIO connected to the board audio codec control bus.

config VIBE_BOX_CODEC_I2C_ADDR
    hex "ES8311 I2C address"
    range 0x08 0x77
    default 0x18
    help
        7-bit I2C address used by the ES8311 codec.

config VIBE_BOX_AUDIO_PA_ENABLE_GPIO
    int "Audio PA enable GPIO"
    range -1 48
    default 42
    help
        Optional GPIO that controls the external power amplifier power rail.

config VIBE_BOX_AUDIO_PA_CONTROL_GPIO
    int "Audio PA control GPIO"
    range -1 48
    default 46
    help
        Optional GPIO that controls the external power amplifier mute or enable pin.

config VIBE_BOX_I2S_PORT
    int "I2S port"
    range 0 1
    default 0
    help
        I2S controller index used for microphone capture.

config VIBE_BOX_I2S_MCLK_GPIO
    int "I2S MCLK GPIO"
    range -1 48
    default 14
    help
        Master clock GPIO connected to the on-board codec.

config VIBE_BOX_I2S_BCLK_GPIO
    int "I2S BCLK GPIO"
    range -1 48
    default 15
    help
        Bit clock GPIO for I2S capture.

config VIBE_BOX_I2S_WS_GPIO
    int "I2S WS GPIO"
    range -1 48
    default 38
    help
        Word select GPIO for I2S capture. The Waveshare ESP32-S3-Touch-ePaper-1.54
        V2 board routes the ES8311 LRCLK (WS) to GPIO 38; GPIO 17 is unconnected.

config VIBE_BOX_I2S_DIN_GPIO
    int "I2S DIN GPIO"
    range -1 48
    default 16
    help
        Serial data input GPIO from the codec ADC into the ESP32.

config VIBE_BOX_I2S_DOUT_GPIO
    int "I2S DOUT GPIO"
    range -1 48
    default 45
    help
        Serial data output GPIO from the ESP32 into the codec DAC.

config VIBE_BOX_I2S_SAMPLE_RATE_HZ
    int "I2S sample rate (Hz)"
    range 8000 48000
    default 16000
    help
        Sample rate used for raw I2S capture.

config VIBE_BOX_I2S_CHANNELS
    int "I2S channels"
    range 1 2
    default 1
    help
        Channel count used for captured PCM data.

config VIBE_BOX_TOUCH_ENABLE
    bool "Enable capacitive touch press-and-hold trigger"
    default y
    help
        When enabled, a finger touch on the e-paper screen starts/stops a
        recording in exactly the same way as the BOOT button.

config VIBE_BOX_TOUCH_RST_GPIO
    int "Touch panel RST GPIO"
    depends on VIBE_BOX_TOUCH_ENABLE
    range -1 48
    default 7
    help
        GPIO connected to the CST816T RST pin (active low). Set to -1 to skip
        the reset pulse entirely.

config VIBE_BOX_TOUCH_INT_GPIO
    int "Touch panel INT GPIO"
    depends on VIBE_BOX_TOUCH_ENABLE
    range -1 48
    default 21
    help
        GPIO connected to the CST816T INT pin. Currently informational only;
        the driver polls register 0x02 over I2C. Set to -1 to skip pin setup.

config VIBE_BOX_TOUCH_I2C_ADDR
    hex "Touch panel I2C address"
    depends on VIBE_BOX_TOUCH_ENABLE
    range 0x08 0x77
    default 0x38
    help
        7-bit I2C address used by the on-board capacitive touch controller.
        Waveshare's V2 board ships with FT6336 at 0x38; some variants use
        CST816T at 0x15.

config VIBE_BOX_TOUCH_POLL_MS
    int "Touch poll interval (ms)"
    depends on VIBE_BOX_TOUCH_ENABLE
    range 5 200
    default 20
    help
        Period at which the touch driver polls the FingerNum register.

config VIBE_BOX_TOUCH_DOUBLE_TAP_MS
    int "Touch double-tap window (ms)"
    depends on VIBE_BOX_TOUCH_ENABLE
    range 150 1500
    default 500
    help
        Maximum interval between two short touch releases to send an Enter key
        over BLE HID.

config VIBE_BOX_TOUCH_TAP_MAX_MS
    int "Touch tap maximum duration (ms)"
    depends on VIBE_BOX_TOUCH_ENABLE
    range 50 1000
    default 300
    help
        Maximum duration for a touch press/release to count as a tap for the
        touch double-tap Enter gesture.

config VIBE_BOX_TOUCH_HOLD_START_MS
    int "Touch hold recording start delay (ms)"
    depends on VIBE_BOX_TOUCH_ENABLE
    range 80 1000
    default 180
    help
        Continuous touch duration required before the touch gesture starts
        recording. Lower values make touch recording feel more responsive.

config VIBE_BOX_WIFI_MAXIMUM_RETRY
    int "Wi-Fi maximum retry count"
    range 1 20
    default 8
    help
        Number of Wi-Fi reconnect attempts before the app marks the network as failed.

endmenu
```

## firmware/sdkconfig.defaults
```kconfig
CONFIG_ESPTOOLPY_FLASHSIZE_8MB=y
CONFIG_PARTITION_TABLE_CUSTOM=y
CONFIG_PARTITION_TABLE_CUSTOM_FILENAME="partitions.csv"
CONFIG_PARTITION_TABLE_FILENAME="partitions.csv"
CONFIG_ESP_MAIN_TASK_STACK_SIZE=8192

CONFIG_BT_ENABLED=y
CONFIG_BT_BLUEDROID_ENABLED=y
CONFIG_BT_BLE_ENABLED=y
CONFIG_BT_GATTS_ENABLE=y
CONFIG_BT_BLE_42_FEATURES_SUPPORTED=y
CONFIG_BT_BTC_TASK_STACK_SIZE=6144

# 8 MB octal PSRAM on the N8R8 module.
CONFIG_SPIRAM=y
CONFIG_SPIRAM_MODE_OCT=y
CONFIG_SPIRAM_TYPE_AUTO=y
CONFIG_SPIRAM_SPEED_80M=y
CONFIG_SPIRAM_BOOT_INIT=y
CONFIG_SPIRAM_USE_MALLOC=y
CONFIG_SPIRAM_TRY_ALLOCATE_WIFI_LWIP=y
CONFIG_SPIRAM_MALLOC_ALWAYSINTERNAL=16384
CONFIG_SPIRAM_MALLOC_RESERVE_INTERNAL=32768
```
